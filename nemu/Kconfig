## nemu/Kconfig
```kconfig
mainmenu "NEMU Configuration Menu"

choice
  prompt "Running System"
  default RunOnLinux

  config RunOnLinux
  bool "Linux"

  config RunOnMacOS
  bool "macOS"

  config RunOnWindows
  bool "Windows"
endchoice

choice
  prompt "Base ISA"
  default ISA_riscv64
config ISA_riscv32
  bool "riscv32"
config ISA_riscv64
  bool "riscv64"
endchoice

config ISA
  string
  default "riscv32" if ISA_riscv32
  default "riscv64" if ISA_riscv64
  default "none"

config ISA64
  depends on ISA_riscv64
  bool
  default y


choice
  prompt "NEMU execution engine"
  default ENGINE_INTERPRETER

config ENGINE_INTERPRETER
  bool "Interpreter"
  help
    Interpreter guest instructions one by one.
endchoice

config ENGINE
  string
  default "interpreter" if ENGINE_INTERPRETER
  default "none"

choice
  prompt "Running mode"
  default MODE_SYSTEM

config MODE_SYSTEM
  bool "System mode"
  help
    Support full-system functionality, including privileged instructions, MMU and devices.
endchoice

choice
  prompt "Build target"
  default TARGET_NATIVE_ELF
config TARGET_NATIVE_ELF
  bool "Executable on Linux Native"
config TARGET_SHARE
  bool "Shared object (used as REF for differential testing)"
config NPC_DIFFTEST_SIMULATION
  bool "NPC DiffTest Simulation (NEMU -> DiffTest -> NPC)"
config TARGET_AM
  bool "Application on Abstract-Machine (DON'T CHOOSE)"
endchoice

menu "RISCV Unprivileged Settings"
config RV64M
  bool "M   Standard Extension for Integer Multiplication and Division"
  default n
config RV64A
  bool "A   Standard Extension for Atomic Instructions"
  default n
config RV64F
  bool "F   Standard Extension for Single-Precision Floating-Point"
  default n
config RV64D
  bool "D   Standard Extension for Double-Precision Floating-Point"
  default n
config RV64Q
  bool "Q   Standard Extension for Quad-Precision Floating-Point"
  default n
config RV64Zfh
  bool "Zfh Standard Extension for Half-Precision Floating-Point"
  default n
config RV64C
  bool "C   Standard Extension for Compressed Instructions"
  default n
config RV64V
  bool "V   Standard Extension for Vector Operations"
  default n
endmenu

menu "RISCV Privileged Settings"
choice 
  prompt "Supported privilege modes"
  default RPS_M
config RPS_M
  bool "M Mode (Simple embedded systems)"
config RPS_MS
  bool "M, S Mode (Secure embedded systems)"
config RPS_MSU
  bool "M, S, U Mode (Systems running Unix-like operating systems)"
endchoice
endmenu

menu "Build Options"
choice
  prompt "Compiler"
  default CC_GCC
config CC_GCC
  bool "gcc"
config CC_GPP
  bool "g++"
config CC_CLANG
  depends on !TARGET_AM
  bool "clang"
endchoice

config CC
  string
  default "gcc" if CC_GCC
  default "g++" if CC_GPP
  default "clang" if CC_CLANG
  default "none"

choice
  prompt "Optimization Level"
  default CC_O2
config CC_O0
  bool "O0"
config CC_O1
  bool "O1"
config CC_O2
  bool "O2"
config CC_O3
  bool "O3"
endchoice

config CC_OPT
  string
  default "-O0" if CC_O0
  default "-O1" if CC_O1
  default "-O2" if CC_O2
  default "-O3" if CC_O3
  default "none"

config CC_LTO
  depends on !TARGET_AM
  bool "Enable link-time optimization"
  default n

config CC_DEBUG
  bool "Enable debug information"
  default n

config CC_ASAN
  depends on MODE_SYSTEM
  bool "Enable address sanitizer"
  default n
endmenu

menu "Testing and Debugging"
config ShowInstInfo
  bool "Show informations for every instruction executed (will significantly reduce executing speed)"
  default n

config ShowInstName
  bool "Show informations name every execution (will be bad for input/output cases)"
  default y

config NPCDiffTest
  bool "DiffTest NPC by comparing with NEMU's result"

config RandomInstructionImage
  bool "Enable Random Instruction Image mode (NEMU only)"
  default n

config InstructionTrace
  bool "Enable itrace (pa2, tested)"
  depends on TRACE
  default n

config InstructionRingBuffer
  bool "Enable iringbuf (pa2, tested)"
  depends on TRACE
  default n

config MemoryTrace
  bool "Enable mtrace (pa2, tested)"
  depends on TRACE
  default n

config RegisterTrace
  bool "Enable rtrace (pa2, tested)"
  depends on TRACE
  default n

config FunctionTrace
  bool "Enable ftrace (pa2, implementing)"
  depends on TRACE
  default n

config TRACE
  bool "Enable tracer"
  default y

config TRACE_START
  depends on TRACE
  int "When tracing is enabled (unit: number of instructions)"
  default 0

config TRACE_END
  depends on TRACE
  int "When tracing is disabled (unit: number of instructions)"
  default 10000

config ITRACE
  depends on TRACE && TARGET_NATIVE_ELF && ENGINE_INTERPRETER
  bool "Enable instruction tracer"
  default y

config ITRACE_COND
  depends on ITRACE
  string "Only trace instructions when the condition is true"
  default "true"


config DIFFTEST
  depends on TARGET_NATIVE_ELF
  bool "Enable differential testing"
  default n
  help
    Enable differential testing with a reference design.
    Note that this will significantly reduce the performance of NEMU.

choice
  prompt "Reference design"
  default DIFFTEST_REF_SPIKE if ISA_riscv64 || ISA_riscv32
  default DIFFTEST_REF_KVM if ISA_x86
  default DIFFTEST_REF_QEMU
  depends on DIFFTEST
config DIFFTEST_REF_QEMU
  bool "QEMU, communicate with socket"
if ISA_riscv64 || ISA_riscv32
config DIFFTEST_REF_SPIKE
  bool "Spike"
endif
if ISA_x86
config DIFFTEST_REF_KVM
  bool "KVM"
endif
endchoice

config DIFFTEST_NOABORT_MODE
  depends on DIFFTEST
  bool "Enable Non-abort mode of difftest (suggest use only in rand_img test mode)"
  default n

config DIFFTEST_OBSERVE_MODE
  depends on DIFFTEST
  bool "Enable Observe mode of difftest (significantly reduce speed)"
  default n

config DIFFTEST_REF_PATH
  string
  default "tools/qemu-diff" if DIFFTEST_REF_QEMU
  default "tools/kvm-diff" if DIFFTEST_REF_KVM
  default "tools/spike-diff" if DIFFTEST_REF_SPIKE
  default "none"

config DIFFTEST_REF_NAME
  string
  default "qemu" if DIFFTEST_REF_QEMU
  default "kvm" if DIFFTEST_REF_KVM
  default "spike" if DIFFTEST_REF_SPIKE
  default "none"
endmenu

if MODE_SYSTEM
source "src/memory/Kconfig"
source "src/device/Kconfig"
endif


menu "Miscellaneous"
choice
  depends on !TARGET_AM
  prompt "Host timer"
  default TIMER_GETTIMEOFDAY
config TIMER_GETTIMEOFDAY
  bool "gettimeofday"
config TIMER_CLOCK_GETTIME
  bool "clock_gettime"
endchoice

config RT_CHECK
  bool "Enable runtime checking"
  default y

endmenu
```

## nsim/Kconfig
```kconfig
mainmenu "NSIM Configuration Menu"

choice
  prompt "Base ISA"
  default ISA_riscv32
config ISA_riscv32
  bool "riscv32"
config ISA_riscv64
  bool "riscv64"
endchoice

config ISA
  string
  default "riscv32" if ISA_riscv32
  default "riscv64" if ISA_riscv64
  default "none"

config ISA64
  depends on ISA_riscv64
  bool
  default y


choice
  prompt "NSIM execution engine"
  default ENGINE_SIMULATER

config ENGINE_SIMULATER
  bool "Simulater"
  help
    Simulate guest instructions one by one.
endchoice

config ENGINE
  string
  default "simulater" if ENGINE_SIMULATER
  default "none"

choice
  prompt "Running mode"
  default MODE_SYSTEM

config MODE_SYSTEM
  bool "System mode"
  help
    Support full-system functionality, including privileged instructions, MMU and devices.
endchoice

choice
  prompt "Build target"
  default TARGET_NATIVE_ELF
config TARGET_NATIVE_ELF
  bool "Executable on Linux Native"
endchoice

menu "simulator configurations"
choice
  prompt "Compiler"
  default CC_GCC
config CC_GCC
  bool "gcc"
config CC_GPP
  bool "g++"
config CC_CLANG
  depends on !TARGET_AM
  bool "clang"
endchoice

config CC
  string
  default "gcc" if CC_GCC
  default "g++" if CC_GPP
  default "clang" if CC_CLANG
  default "none"

choice
  prompt "Optimization Level"
  default CC_O2
config CC_O0
  bool "O0"
config CC_O1
  bool "O1"
config CC_O2
  bool "O2"
config CC_O3
  bool "O3"
endchoice

config CC_OPT
  string
  default "-O0" if CC_O0
  default "-O1" if CC_O1
  default "-O2" if CC_O2
  default "-O3" if CC_O3
  default "none"

config CC_LTO
  depends on !TARGET_AM
  bool "Enable link-time optimization"
  default n

config CC_DEBUG
  bool "Enable debug information"
  default n

config CC_ASAN
  depends on MODE_SYSTEM
  bool "Enable address sanitizer"
  default n
endmenu

menu "Testing and Debugging"
config ShowInstInfo
  bool "Show informations for every instruction executed (will significantly reduce executing speed)"
  default n

endmenu

if MODE_SYSTEM
source "src/memory/Kconfig"
source "src/device/Kconfig"
endif


menu "Miscellaneous"
choice
  depends on !TARGET_AM
  prompt "Host timer"
  default TIMER_GETTIMEOFDAY
config TIMER_GETTIMEOFDAY
  bool "gettimeofday"
config TIMER_CLOCK_GETTIME
  bool "clock_gettime"
endchoice

config RT_CHECK
  bool "Enable runtime checking"
  default y

endmenu
```

## rrdb/Kconfig
```kconfig
mainmenu "RRDB Configuration Menu"

choice
  prompt "Base ISA"
  default ISA_riscv64
config ISA_riscv64
  bool "riscv64"
endchoice

config ISA
  string
  default "riscv64" if ISA_riscv64
  default "none"

config ISA64
  depends on ISA_riscv64
  bool
  default y


choice
  prompt "RRDB execution engine"
  default ENGINE_INTERPRETER

config ENGINE_INTERPRETER
  bool "Interpreter"
  help
    Interpreter guest instructions one by one.
endchoice

config ENGINE
  string
  default "interpreter" if ENGINE_INTERPRETER
  default "none"

choice
  prompt "Running mode"
  default MODE_SYSTEM

config MODE_SYSTEM
  bool "System mode"
  help
    Support full-system functionality, including privileged instructions, MMU and devices.
endchoice

choice
  prompt "Build target"
  default TARGET_NATIVE_ELF
config TARGET_NATIVE_ELF
  bool "Executable on Linux Native"
endchoice

menu "Build Options"
choice
  prompt "Compiler"
  default CC_GCC
config CC_GCC
  bool "gcc"
config CC_GPP
  bool "g++"
config CC_CLANG
  depends on !TARGET_AM
  bool "clang"
endchoice

config CC
  string
  default "gcc" if CC_GCC
  default "g++" if CC_GPP
  default "clang" if CC_CLANG
  default "none"

choice
  prompt "Optimization Level"
  default CC_O2
config CC_O0
  bool "O0"
config CC_O1
  bool "O1"
config CC_O2
  bool "O2"
config CC_O3
  bool "O3"
endchoice

config CC_OPT
  string
  default "-O0" if CC_O0
  default "-O1" if CC_O1
  default "-O2" if CC_O2
  default "-O3" if CC_O3
  default "none"

config CC_LTO
  depends on !TARGET_AM
  bool "Enable link-time optimization"
  default n

config CC_DEBUG
  bool "Enable debug information"
  default n

config CC_ASAN
  depends on MODE_SYSTEM
  bool "Enable address sanitizer"
  default n
endmenu

menu "Testing and Debugging"


config DIFFTEST
  depends on TARGET_NATIVE_ELF
  bool "Enable differential testing"
  default n
  help
    Enable differential testing with a reference design.
    Note that this will significantly reduce the performance of NEMU.

choice
  prompt "Reference design"
  default DIFFTEST_REF_SPIKE if ISA_riscv64 || ISA_riscv32
  default DIFFTEST_REF_QEMU
  depends on DIFFTEST
config DIFFTEST_REF_QEMU
  bool "QEMU, communicate with socket"
if ISA_riscv64 || ISA_riscv32
config DIFFTEST_REF_SPIKE
  bool "Spike"
endif
endchoice

config DIFFTEST_REF_PATH
  string
  default "tools/qemu-diff" if DIFFTEST_REF_QEMU
  default "tools/spike-diff" if DIFFTEST_REF_SPIKE
  default "none"

config DIFFTEST_REF_NAME
  string
  default "qemu" if DIFFTEST_REF_QEMU
  default "spike" if DIFFTEST_REF_SPIKE
  default "none"
endmenu

if MODE_SYSTEM
source "src/memory/Kconfig"
source "src/device/Kconfig"
endif


menu "Miscellaneous"
choice
  depends on !TARGET_AM
  prompt "Host timer"
  default TIMER_GETTIMEOFDAY
config TIMER_GETTIMEOFDAY
  bool "gettimeofday"
config TIMER_CLOCK_GETTIME
  bool "clock_gettime"
endchoice

config RT_CHECK
  bool "Enable runtime checking"
  default y

endmenu
```

## sim/Kconfig
```kconfig
mainmenu "NSIM Configuration Menu"

choice
    prompt "Running System"
    default RunOnLinux

    config RunOnLinux
    bool "Linux"

    config RunOnMacOS
    bool "macOS"

    config RunOnWindows
    bool "Windows"
endchoice

choice
    prompt "CPU Bits"
    default XLEN_64
config XLEN_32
    bool "32 Bit CPU Design"
config XLEN_64
    bool "64 Bit CPU Design"
endchoice

menu "Build Options"
choice
    prompt "Compiler"
    default CC_GCC
config CC_GCC
    bool "gcc"
config CC_GPP
    bool "g++"
config CC_CLANG
    bool "clang"
endchoice

config CC
    string
    default "gcc" if CC_GCC
    default "g++" if CC_GPP
    default "clang" if CC_CLANG
    default "none"

choice
    prompt "Optimization Level"
    default CC_O2
config CC_O0
    bool "O0"
config CC_O1
    bool "O1"
config CC_O2
    bool "O2"
config CC_O3
    bool "O3"
endchoice

config CC_OPT
    string
    default "-O0" if CC_O0
    default "-O1" if CC_O1
    default "-O2" if CC_O2
    default "-O3" if CC_O3
    default "none"
endmenu

menu "Testing and Debugging"
config DifftestWithNEMU
    bool "Difftest NPC (as DUT) with NEMU (as REF)"

config ShowInstName
    bool "Show instruction name every NPC execution"

config ShowNPCInfo
    bool "Show NPC's info every NPC execution (Mem & Reg)"

config ITRACE
    bool "Enable Instruction Tracer"

config MTRACE
    bool "Enable Memory Tracer"

config FTRACE
    bool "Enable Function Tracer"

config DTRACE
    bool "Enable Device Tracer"

config RTRACE
    bool "Enable Register Tracer"

config RTRACE_CSR
    depends on RTRACE
    bool "R-Trace Control State Registers"

config RTRACE_GPR
    depends on RTRACE
    bool "R-Trace General Purpose Registers"

config RTRACE_CSR
    depends on RTRACE
    bool "R-Trace Float Point Registers"

config RTRACE_AIR
    depends on RTRACE
    bool "R-Trace Atomic Instruction Registers"

endmenu

menu "Miscellaneous"
choice
    prompt "Host timer"
    default TIMER_GETTIMEOFDAY
config TIMER_GETTIMEOFDAY
    bool "gettimeofday"
config TIMER_CLOCK_GETTIME
    bool "clock_gettime"
endchoice

endnemu
```

## sim/src/memory/Kconfig
```kconfig
menu "Memory Configuration"

config MBASE
    hex "Memory base address"
    default 0x80000000

config MSIZE
    hex "Memory size"
    default 0x10000000

config PC_RESET_OFFSET
    hex "Offset of reset vector from the base of memory"
    default 0

choice
    prompt "Physical memory definition"
    default PMEM_GARRAY
config PMEM_MALLOC
    bool "Using malloc()"
config PMEM_GARRAY
    bool "Using global array"
endchoice
```
